## rv1126_rv1109_linux_ai_camera/buildroot/configs/firefly_rv1126_rv1109_uvcc_defconfig
```kconfig
#include "base.config"
#include "debug.config"
#include "audio.config"
#include "video_mpp.config"
#include "rv1126_rv1109_arm.config"
BR2_ROOTFS_OVERLAY="board/rockchip/rv1126_rv1109/fs-overlay-uvc/"
BR2_PACKAGE_GDB=y
BR2_PACKAGE_GDB_DEBUGGER=y
BR2_PACKAGE_SHM_TOOLS=y
BR2_PACKAGE_LIBIPCPROTOCOL=y
BR2_PACKAGE_RK_OEM=y
BR2_PACKAGE_RK_OEM_RESOURCE_DIR="$(TOPDIR)/../device/rockchip/oem/oem_uvcc"
BR2_PACKAGE_CAMERA_ENGINE_RKAIQ=y
BR2_PACKAGE_CAMERA_ENGINE_RKAIQ_IQFILE="os04a10_CMK-OT1607-FV1_M12-40IRC-4MP-F16.xml gc4c33_PCORW0009A_40IRC-4M.xml imx378_A12N01B_48IRC-12M-F18.xml"
BR2_PACKAGE_DBUS_GLIB=y
BR2_PACKAGE_LIBV4L=y
BR2_PACKAGE_LIBV4L_UTILS=y
BR2_PACKAGE_UVC_APP=y
BR2_PACKAGE_RKNPU_NOT_RUN_RKNN_SERVER=y
BR2_PACKAGE_ROCKX=y
BR2_PACKAGE_CALLFUNIPC=y
BR2_PACKAGE_ISP2_IPC=y
BR2_PACKAGE_ISP2_IPC_DBUS=y
BR2_PACKAGE_ISP2_IPC_DBSERVER=y
BR2_PACKAGE_DBSERVER=y

#  - we have to use eudev, because need udev support
BR2_ROOTFS_DEVICE_CREATION_DYNAMIC_EUDEV=y
#  - we need to use fsck and resize2fs to check and extend ext2/4 file system when the first time system boot up
BR2_PACKAGE_E2FSPROGS=y
BR2_PACKAGE_E2FSPROGS_FSCK=y
BR2_PACKAGE_E2FSPROGS_RESIZE2FS=y
#  - usb device package used to init and config udc like adb and usb mass storage
BR2_PACKAGE_USBDEVICE=y
#  - we need adb as the basic tool
BR2_PACKAGE_ANDROID_TOOLS=y

# aiserver config
BR2_PACKAGE_AISERVER=y
BR2_PACKAGE_AISERVER_SHM_SERVER=y
BR2_PACKAGE_AISERVER_USE_ROCKX=y
BR2_PACKAGE_ROCKIT=y
BR2_PACKAGE_FFMPEG_ENCODERS=""
BR2_PACKAGE_FFMPEG_DECODERS=""
BR2_PACKAGE_FFMPEG_MUXERS=""
BR2_PACKAGE_FFMPEG_DEMUXERS=""
BR2_PACKAGE_FFMPEG_PARSERS=""
BR2_PACKAGE_FFMPEG_BSFS=""
BR2_PACKAGE_FFMPEG_PROTOCOLS=""
BR2_PACKAGE_FFMPEG_FILTERS=""

# firefly
BR2_ROOTFS_OVERLAY="board/rockchip/rv1126_rv1109/fs-overlay-uvc/ board/firefly/dual_aicam_rv1109_common/overlayfs"
BR2_PACKAGE_CAMERA_ENGINE_RKAIQ_IQFILE="gc2093_FF-RV1109-2-V1_40IR-2MP-F20.xml gc2093_YT-RV1109-2-V1_40IR-2MP-F20.xml ov2718_YT-RV1109-3-V1_M43-4IR-2MP-F2.xml gc2053_YT-RV1109-2-V1_40IR-2MP-F20.xml"
#BR2_PACKAGE_STRESS=y
BR2_PACKAGE_LIBCAP=y
BR2_PACKAGE_LIBCAP_TOOLS=y
BR2_TARGET_LOCALTIME="Asia/Shanghai"
BR2_PACKAGE_NTP_NTPDATE=y
BR2_PACKAGE_NTP=y
BR2_PACKAGE_RK_OEM_RESOURCE_DIR="$(TOPDIR)/../device/rockchip/oem/oem_firefly_uvcc"
BR2_PACKAGE_NGINX=y
BR2_PACKAGE_NGINX_HTTP_SSL_MODULE=y
BR2_PACKAGE_NGINX_DEBUG=y
BR2_PACKAGE_NGINX_RTMP=y
BR2_PACKAGE_STRESS=y

# RKMedia
BR2_PACKAGE_RKMEDIA_RKNN=y
BR2_PACKAGE_RKMEDIA=y
BR2_PACKAGE_RKMEDIA_V4L2_CAPTURE=y
BR2_PACKAGE_RKMEDIA_USE_AIQ=y
BR2_PACKAGE_DRM_DISPLAY_OUTPUT=y
BR2_PACKAGE_RKMEDIA_MPP=y
BR2_PACKAGE_RKMEDIA_ALSA=y
BR2_PACKAGE_RKMEDIA_ALSA_PLAYBACK=y
BR2_PACKAGE_RKMEDIA_ALSA_CAPTURE=y
BR2_PACKAGE_RKMEDIA_AUDIO_ALGORITHM=y
BR2_PACKAGE_RKMEDIA_AUDIO_CODEC=y
BR2_PACKAGE_RKMEDIA_AUDIO_ENCODER=y
BR2_PACKAGE_RKMEDIA_AUDIO_DECODER=y
BR2_PACKAGE_RKMEDIA_RKRGA=y
BR2_PACKAGE_RKMEDIA_MOVE_DETECTION=y
BR2_PACKAGE_RKMEDIA_OCCLUSION_DETECTION=y
BR2_PACKAGE_RKMEDIA_EXAMPLES=y
BR2_PACKAGE_RKMEDIA_LIVE555=y
BR2_PACKAGE_RKMEDIA_RTSP_SERVER=y
BR2_PACKAGE_RKMEDIA_RTSP_SERVER_H264=y

# OPENCV3
BR2_PACKAGE_OPENCV3=y
BR2_PACKAGE_OPENCV3_LIB_IMGCODECS=y
BR2_PACKAGE_OPENCV3_LIB_IMGPROC=y
BR2_PACKAGE_OPENCV3_WITH_JPEG=y
BR2_PACKAGE_OPENCV3_WITH_PNG=y

# On-Device AI
BR2_PACKAGE_MICROPYTHON=y
BR2_PACKAGE_MICROPYTHON_LIB=y

BR2_PACKAGE_TFLITE_MICRO=y
BR2_PACKAGE_MICROAI=y
BR2_PACKAGE_MICROAI_FUNCTEST=y
```

## rv1126_rv1109_linux_ai_camera/buildroot/package/microai/Config.in
```kconfig
config BR2_PACKAGE_MICROAI
	bool "microai"
	depends on BR2_PACKAGE_TFLITE_MICRO
	depends on BR2_PACKAGE_LIBV4L	
	depends on BR2_PACKAGE_OPENCV3	
	help
	  microAI : The tflite-micro library and its wrapper functions

	  https://on-device-ai.com/
```

## rv1126_rv1109_linux_ai_camera/buildroot/package/microai_functest/Config.in
```kconfig
config BR2_PACKAGE_MICROAI_FUNCTEST
	bool "microai_functest"
	depends on BR2_PACKAGE_MICROAI
	help
	  The microAI library unit test program

	  https://on-device-ai.com/
```

## rv1126_rv1109_linux_ai_camera/buildroot/package/tflite-micro/Config.in
```kconfig
config BR2_PACKAGE_TFLITE_MICRO
	bool "tflite-micro"
	help
	  TensorFlow Lite for Microcontrollers is a port of TensorFlow 
	  Lite designed to run machine learning models on DSPs, 
	  microcontrollers and other devices with limited memory.

	  https://github.com/tensorflow/
```
